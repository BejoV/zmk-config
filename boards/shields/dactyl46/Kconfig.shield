## boards/shields/dactyl46/Kconfig.shield
```kconfig
config SHIELD_DACTYL46_LEFT
    def_bool $(shields_list_contains,dactyl46_left)

config SHIELD_DACTYL46_RIGHT
    def_bool $(shields_list_contains,dactyl46_right)
```

## boards/shields/dactyl46_left/Kconfig.defconfig
```kconfig
if SHIELD_DACTYL46_LEFT

config ZMK_KEYBOARD_NAME
    default "Dactyl46 L"

endif
```

## boards/shields/dactyl46_right/Kconfig.defconfig
```kconfig
if SHIELD_DACTYL46_RIGHT

config ZMK_KEYBOARD_NAME
    default "Dactyl46 R"

endif
```

## boards/shields/dactyl46_right/Kconfig.shield
```kconfig
config SHIELD_DACTYL46_RIGHT
    def_bool $(shields_list_contains,dactyl46_right)
```

## config/boards/shields/dactyl_left/Kconfig.defconfig
```kconfig
if SHIELD_DACTYL_LEFT

config ZMK_KEYBOARD_NAME
    default "Dactyl Left"

endif
```

## config/boards/shields/dactyl_right/Kconfig.defconfig
```kconfig
if SHIELD_DACTYL_RIGHT

config ZMK_KEYBOARD_NAME
    default "Dactyl Right"

endif
```

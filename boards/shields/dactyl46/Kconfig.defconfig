## boards/shields/dactyl46/Kconfig.defconfig
```kconfig
if SHIELD_DACTYL46_LEFT

config ZMK_KEYBOARD_NAME
    default "Dactyl46"

config ZMK_SPLIT
    default y

config ZMK_SPLIT_ROLE_CENTRAL
    default y

endif

if SHIELD_DACTYL46_RIGHT

config ZMK_KEYBOARD_NAME
    default "Dactyl46"

config ZMK_SPLIT
    default y

config ZMK_SPLIT_ROLE_PERIPHERAL
    default y

endif
```

#include <behaviors.dtsi>
#include <dt-bindings/zmk/keys.h>
#include <dt-bindings/zmk/bt.h>
#include <dt-bindings/zmk/outputs.h>

#define BASE 0
#define SYM  1
#define SYS  2

/ {
    behaviors {
        lang: lang_switch {
            compatible = "zmk,behavior-macro";
            #binding-cells = <0>;
            bindings
                = <&macro_press   &kp LSHIFT>
                , <&macro_press   &kp LALT>
                , <&macro_pause_for_release>
                , <&macro_release &kp LALT>
                , <&macro_release &kp LSHIFT>
                ;
        };
    };

    keymap {
        compatible = "zmk,keymap";

        /* BASE — QWERTY, правая половина */
        base_layer {
            bindings = <
&kp N6     &kp N7     &kp N8     &kp N9     &kp N0     &kp BSPC
&kp Y      &kp U      &kp I      &kp O      &kp P      &kp SQT
&kp H      &kp J      &kp K      &kp L      &kp SEMI   &kp ENTER
&mo SYM    &kp SPACE  &kp N      &kp M      &kp COMMA
            >;
        };

        sym_layer {
            bindings = <
&kp F6     &kp F7     &kp F8     &kp F9     &kp F10    &kp DEL
&kp CARET  &kp AMPS   &kp ASTRK  &kp LPAR   &kp RPAR   &kp DQT
&kp LBRC   &kp RBRC   &kp DOT    &kp FSLH   &kp QMARK  &trans
&mo SYS    &trans     